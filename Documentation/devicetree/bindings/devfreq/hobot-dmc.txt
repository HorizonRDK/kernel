## drivers/soc/hobot/debug/Kconfig
```kconfig
config HOBOT_HARDLOCKUP_DETECTOR
	bool "support the hard deadlock detection"
	help
	  support the hard deadlock detection.

config HOBOT_CORESIGHT
	bool "support coresight features"
	help
	  Support coresight features such as dump pcsr, trigger panic etc.

config HOBOT_FIQ_DEBUGGER
    tristate "support fiq debugger after hardlock"
    help
        Support fiq debugger to get registers, backtrace
config HOBOT_SCHED_LOGGER
	tristate "HOBOT Sched Switch Logger Support"
	depends on ARCH_HOBOT
	default n
	help
	  support the sched switch debugging in release version.
```

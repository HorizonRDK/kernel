## Documentation/devicetree/bindings/devfreq/hobot-dmc.txt
```
* Horizon j5 DMC(Dynamic Memory Controller) device

Required properties:
- compatible:		 Must be "hobot,j5-dmc".
- devfreq-events:	 Node to get DDR loading, Refer to
			 Documentation/devicetree/bindings/devfreq/
			 rockchip-dfi.txt
- clocks:		 Phandles for clock specified in "clock-names" property
- clock-names :		 The name of clock used by the DFI, must be
			 "pclk_ddr_mon";
- operating-points-v2:	 Refer to Documentation/devicetree/bindings/power/opp.txt
			 for details.
- status:		 Marks the node enabled/disabled.

Following properties are ddr timing:

Example:
	dmc_opp_table: dmc_opp_table {
		compatible = "operating-points-v2";

		opp00 {
			opp-hz = /bits/ 64 <300000000>;
			opp-microvolt = <900000>;
		};
		opp01 {
			opp-hz = /bits/ 64 <666000000>;
			opp-microvolt = <900000>;
		};
	};

	dmc: dmc {
		compatible = "hobot,j5-dmc";
		devfreq-events = <&dfi>;
		clocks = <&cru SCLK_DDRCLK>;
		clock-names = "dmc_clk";
		operating-points-v2 = <&dmc_opp_table>;
	};
```

## Documentation/devicetree/bindings/reset/hobot-reset.txt
```
Hisilicon System Reset Controller
======================================

Please also refer to reset.txt in this directory for common reset
controller binding usage.

The reset controller registers are part of the system-ctl block on hobot SoC.

Required properties:
- compatible: should be
		 "hobot,x2-reset"
- #reset-cells : Specifies the number of cells needed to encode a
  reset source.  The type shall be a <u32> and the value shall be 2.

	 Cell #1 : offset of the reset assert control
	           register from the syscon register base
	 Cell #2 : bit position of the reset in the reset control register

Example:
	rst: reset-controller {
		compatible = "hobot,x2-reset";
		#reset-cells = <2>;
	};

Specifying reset lines connected to IP modules
==============================================
example:

        ips: ips@..... {
                ...
		resets = <&rst 0x40 2>; /* offset: 0x40; bit: 2 */
                ...
        };
```

## drivers/bifsd/Kconfig
```kconfig
config X2_BIFSD_DEV
	bool "Bif SD device driver support"
	default y
        help
          This supports Bif SD Card protocol drivers.

          Note that this application programming interface is EXPERIMENTAL
          and hence SUBJECT TO CHANGE WITHOUT NOTICE while it stabilizes.
```

## drivers/clk/hobot/Kconfig
```kconfig
config HOBOT_COMMON_CLK
	bool "HOBOT clock controller support"
config CLK_HOBOT_COMMON_TEST
	bool "HOBOT clock controller test support"
config HOBOT_CPU_CLK_X2
	bool "HOBOT cpu clk support for x2"
config HOBOT_CPU_CLK_X3
	bool "HOBOT cpu clk support for x3"
config HOBOT_CNN_CLK_X3
	bool "HOBOT cnn clk support for x3"
config HOBOT_DMC_CLK
    bool "HOBOT dmc clk"
config HOBOT_BUS_CLK_X3
	bool "HOBOT bus clk support for x3"
```

## drivers/gpu/drm/avb/Kconfig
```kconfig
config DRM_AVB
	tristate "Video Broadcasting Over TSN"
	depends on DRM && TSN
	select DRM_KMS_HELPER
	select DRM_KMS_CMA_HELPER
	help
	  Choose this option to enable video output over TSN.
```

## drivers/iar/Kconfig
```kconfig
#
# IPS configuration
#

menu "IAR Configuratio"
config X2_IAR
	tristate "X2 IAR Drivers"
	default n
	---help---
	   Drivers for the X2 IAR

endmenu
```

## drivers/input/quad_j2id/Kconfig
```kconfig
#
# MATRIX QUAD j2_id configuration
#
config QUAD_J2ID
	tristate "matrix v2.0 quad j2 identify"
	default n
	help
	  Say Y here if you need to identify each j2 on board.

	  To compile this driver as a module, choose M here: the
	  module will be called j2_id.
```

## drivers/ips/Kconfig
```kconfig
#
# IPS configuration
#

menu "IPS Configuratio"
config HOBOT_IPS_X2
	tristate "X2 IPS Drivers"
	default n
	---help---
	   Drivers for the X2 IPS

config USRDRV
	tristate "USRDRV Driver"
	---help---
	   Driver for the user mode driver

if HOBOT_IPS_X2

config HOBOT_IPU_X2
	tristate "X2 IPU Driver"
	---help---
	   Driver for the X2 IPU

config HOBOT_SIF_X2
	tristate "X2 SIF Driver"
	---help---
	   Driver for the X2 SIF

config HOBOT_ISP_X2
	tristate "X2 ISP Driver"
	---help---
	   Driver for the X2 ISP

endif
endmenu
```

## drivers/md/hobot/Kconfig
```kconfig
choice
	prompt "Default unbind key"
	default AES_HASH_BIND_KEY_NULL
	help
	  Default unbind source aes key

config AES_HASH_BIND_KEY_NULL
	bool "Unbind"
	help
	  Disable bind source aes key and socuid by hobot soft hash

config AES_HW_HASH_BIND_KEY
	bool "Hw_bind"
	depends on CRYPTO_DEV_HOBOT_DEV
	depends on CRYPTO_DEV_HOBOT_EXAMPLE
	depends on CRYPTO_DEV_HOBOT_CRYPTO
	depends on CRYPTO_DEV_HOBOT_RSA
	depends on CRYPTO_DEV_HOBOT_TRNG
	help
	  Enables bind source aes key and socuid by hobot hardware hash

config AES_SOFT_HASH_BIND_KEY
	bool "Soft_bind"
	help
	  Enables bind source aes key and socuid by hobot soft hash
endchoice

config USE_AES_CONFIG_KEY
	string "User_key"
	# depends on AES_SOFT_HASH_BIND_KEY || AES_HW_HASH_BIND_KEY
	default ""
	help
	  Bind aes defconfig key and socuid by hash
```

## drivers/media/platform/avb/Kconfig
```kconfig
config VIDEO_AVB
	tristate "Video Recording Over TSN"
	depends on TSN && VIDEO_V4L2
	select VIDEOBUF2_DMA_CONTIG
	help
	  Choose this option to enable video input over TSN.
```

## drivers/media/platform/hobot/Kconfig
```kconfig
#
# VIO configuration
#

menu "VIO Configuratio"
config HOBOT_VIO
	tristate "HOBOT VIO Drivers"
	default n
	---help---
	   Drivers for the HOBOT VIO

endmenu

source "drivers/media/platform/hobot/isp/Kconfig"

config HOBOT_MIPI_CSI
	bool "Hobot MIPI CSI Drivers"
	depends on ARCH_HOBOT || ARCH_ZYNQMP
	---help---
	  Drivers for the Hobot MIPI CSI

source "drivers/media/platform/hobot/mipi/Kconfig"
```

## drivers/media/platform/hobot/isp/Kconfig
```kconfig
#
# hobot isp driver config
#
config VIDEO_HOBOT_ISP
	tristate "HOBOT C-series ISP v4l2 driver"
	depends on VIDEO_DEV
	depends on VIDEO_V4L2_SUBDEV_API
	depends on VIDEO_V4L2
	select VIDEOBUF_GEN
	select VIDEOBUF2_CORE
	select VIDEOBUF2_MEMOPS
	select VIDEOBUF2_VMALLOC
	select VIDEOBUF2_DMA_CONTIG
	---help---
         Say Y here to enable support for HOBOT C-series ISP V4L2 driver.
```

## drivers/media/platform/hobot/mipi/Kconfig
```kconfig
#
# hobot mipi configuration
#

config HOBOT_MIPI_HOST
    tristate "Hobot MIPI Host Driver"
	depends on HOBOT_MIPI_CSI
	---help---
      Driver for the HOBOT MIPI Host

config HOBOT_MIPI_HOST_MAX_NUM
    int "Hobot MIPI host max port num"
	depends on HOBOT_MIPI_HOST
	default 4 if HOBOT_XJ3 || ARCH_ZYNQMP
	default 1 if HOBOT_XJ2
	---help---
      Max num of mipi host devices

config HOBOT_MIPI_DEV
    tristate "Hobot MIPI Device Driver"
	depends on HOBOT_MIPI_CSI
	---help---
      Driver for the HOBOT MIPI Device

config HOBOT_MIPI_DEV_MAX_NUM
    int "Hobot MIPI dev max port num"
	depends on HOBOT_MIPI_DEV
	default 1
	---help---
      Max num of mipi dev devices

config HOBOT_MIPI_PHY
    tristate "Hobot MIPI DPHY Driver"
	depends on HOBOT_MIPI_CSI || (HOBOT_XJ3 && HOBOT_IAR)
	---help---
      Driver for the HOBOT MIPI DPHY

config HOBOT_MIPI_CLK_RECALCULATION
    bool "ENABLE CLK ACCURACY IMPROVE"
	depends on HOBOT_MIPI_CSI
    default n
	---help---
      code for clk accuracy improve

config HOBOT_MIPI_REG_OPERATE
    bool "ENABLE REG IOCTL OPERATE"
	depends on HOBOT_MIPI_CSI
    default n
	---help---
      enable mipi devices' reg ioctl opreate
```

## drivers/misc/bt2hdmi-lt/Kconfig
```kconfig
#
# BT2HDMI device configuration
#
config HOBOT_HDMI_LT8618
	tristate "LT8618SXB HDMI Drivers"
	default m
	---help---
	Drivers for the LT8618SXB BT2HDMI chip
```

## drivers/misc/bt2hdmi/Kconfig
```kconfig
#
# BT2HDMI device configuration
#
config HOBOT_HDMI
	tristate "HDMI Drivers"
	default y
	---help---
	Drivers for the Sii9022A BT2HDMI chip
```

## drivers/misc/bt2mipi/Kconfig
```kconfig
#
# BT2MIPI BT2RGB configuration
#
#
config HOBOT_MIPI
	tristate "X2 LT9211 Drivers"
	default y
	---help---
	   Drivers for the BT2MIPI LT9211 chip
```

## drivers/misc/timesync/Kconfig
```kconfig
config HOBOT_TIMESYNC
	tristate "timesync with MCU"
	default n
	help
	This is the timesync test driver --by zhongzhen.

config TIMESYNC_DEBUG
	tristate "timesync debug"
	default n
	depends on HOBOT_TIMESYNC
	help
	This is the for timesync debug.
```

## drivers/mtd/nand/spi/Kconfig
```kconfig
menuconfig MTD_SPI_NAND
	tristate "SPI NAND device Support"
	select MTD_NAND_CORE
	depends on SPI_MASTER
	select SPI_MEM
	help
	  This is the framework for the SPI NAND device drivers.

	config SPINAND_ESMT
	bool "Enable ESMT spi-nand detect"
	default n
	depends on MTD_SPI_NAND
	help
	  This option will enable ESMT spinand flash detection, which will
	  disable Micron spinand flash detection. If unsure, please select n
```

## drivers/net/ethernet/hobot/Kconfig
```kconfig
#
# Horizon network device configuration
#

config NET_VENDOR_HOBOT
	bool "Hobot x2 ethernet devices"
	default y
	---help---
	  If you have a network (Ethernet) device belonging to this class, say Y.

if NET_VENDOR_HOBOT

config X2_ETH
	tristate "Hobot X2 Ethernet Device support"
	select PHYLIB
	select CRC32
	select MII
	depends on OF && HAS_DMA
	---help---
	  This driver supports the X2 Ethernet device from Hobot

config X2A_ETH
	tristate "Hobot X2A Ethernet Device support"
	select PHYLIB
	select CRC32
	select MII
	depends on OF && HAS_DMA
	---help---
	  This driver supports the X2A Ethernet device from Hobot

endif # NET_VENDOR_HOBOT
```

## drivers/pinctrl/hobot/Kconfig
```kconfig
config PINCTRL_HOBOT_X2
	bool "Hobot x2 pinctrl driver"
	depends on ARCH_HOBOT
	select PINMUX
	select GENERIC_PINCONF
	select GPIOLIB_IRQCHIP

config HOBOT_PINCTRL_CDEV
	bool "Hobot pinctrl cdev driver"
	depends on ARCH_HOBOT
	select PINMUX
	select GENERIC_PINCONF
	select GPIOLIB_IRQCHIP
```

## drivers/soc/hobot/Kconfig
```kconfig
#
# Hobot MPSoC configuration
#
menuconfig HOBOT_SOC_DRIVERS
        bool "HOBOT SOC drivers support"
        depends on ARCH_HOBOT

config HOBOT_SOCINFO
        tristate "Enable hobot socinfo driver "
        default n
        help
          Say yes to enable hobot socinfo driver In doubt, say N

if HOBOT_SOC_DRIVERS

config HOBOT_CNN_HOST
        tristate "Enable hobot CNN HOST Drivers"
        default n
        help
          Say yes to enable hobot cnn driver In doubt, say N

config HOBOT_FUSA
		tristate "Enable J3 FUSA FATAL Drivers"
		default n
		help
			Say yes to enable J3 fusa fatal api driver In doubt, say N

config HOBOT_CNN_MM
        bool "hobot CNN Memory Heap Drivers"
        default n
        help
          Add hobot cnn memory heap management driver

source "drivers/soc/hobot/bpu/Kconfig"

config HOBOT_RAMDUMP
        bool "hobot ramdump support"
        default n
        depends on KEXEC
        help
          Enable hobot ramdump support

config HOBOT_DIAG
        bool "hobot diag driver, based on netlink"
        default n
        help
          Kernel modules(drivers) can send diag msgs to userspace
          by calling the API of the diag module(driver)

config HOBOT_MCU_IRQ
        tristate "Time sync driver with MCU by 2 GPIO"
        default n
        help
          Get mcu state&send irq and return timestamp


menuconfig HOBOT_BIF_CP
        bool "Enable Horizon CP side BIF driver"
        default n
        help
          Enable when BIF driver built in CP side

if HOBOT_BIF_CP
config HOBOT_BIFSPI_DEV
        bool "Bif SPI device driver support"
        default n
	help
	    Say Y here if you want to support read/write bif share register

config HOBOT_BIFSD_DEV
	bool "Bif SD device driver support"
	default y
        help
          This supports Bif SD Card protocol drivers.

          Note that this application programming interface is EXPERIMENTAL
          and hence SUBJECT TO CHANGE WITHOUT NOTICE while it stabilizes.

config HOBOT_BIF_BASE
        tristate "Enable HOBOT BIF Base Drivers"
        default n
        help
          Horizon Robotics chip support BIFSPI and BIFSD interface, this driver provide basic API
          to other driver like virtual ethernet and virtual serial port
          Say yes to enable bif base driver In doubt, say N

config HOBOT_BIF_ETHERNET
        tristate "Enable HOBOT BIF Ethernet Drivers"
	depends on HOBOT_BIF_BASE
        default n
        help
          Say yes to enable bif virtual ethernet driver In doubt, say N

config HOBOT_BIF_SIO
        tristate "Enable HOBOT BIF SIO Drivers"
	depends on HOBOT_BIF_BASE
        default n
        help
          Say yes to enable bif virtual sieral port driver

config HOBOT_BIF_LITE_CORE
        tristate "Enable HOBOT BIF Lite Drivers"
	depends on HOBOT_BIF_BASE
        default n
        help
          Say yes to enable bif_lite_core driver

config HOBOT_BIF_LITE_SPI
        tristate "Enable HOBOT BIF Lite SPI Drivers"
	depends on HOBOT_BIF_LITE_CORE
        default n
        help
          Say yes to enable bif_lite_spi driver

config HOBOT_BIF_LITE_SD
        tristate "Enable HOBOT BIF Lite SD Drivers"
	depends on HOBOT_BIF_LITE_CORE
        default n
        help
          Say yes to enable bif_lite_sd driver

config HOBOT_BIF_LITE_ETH
        tristate "Enable HOBOT BIF Lite ETH Drivers"
	depends on HOBOT_BIF_LITE_CORE && HOBOT_BIF_ETHERNET
        default n
        help
          Say yes to enable bif_lite_eth driver

config HOBOT_HBIPC_ETH
        tristate "Enable HBIPC Ethernet Drivers"
        default n
        help
          Say yes to enable bif_lite_sd driver

endif

config HOBOT_DDR_MON
	bool "Enable HOBOT DDR Monitor"
	default n
	help
	  say yes to enable hobot ddr monitor

config HOBOT_APB_TIMEOUT
	bool "Enable APB timeout detection module"
	default n
	help
	  say yes to enable hobot APB timeout detection module

config HOBOT_SSCG
	tristate "Enable HOBOT Spread Specturm"
	default n
	help
	  say yes to enable spread specturm

config HOBOT_PM
	bool "Enable HOBOT suspend"
	default n
	help
	  say yes to enable hobot suspend

config HOBOT_IAR
	tristate "HOBOT IAR Drivers"
	default n
	---help---
	   Drivers for the HOBOT IAR

config HOBOT_VCAM
        tristate "Enable HOBOT VCAM Drivers"
        default n
        help
          Say yes to enable vcam driver

config HOBOT_XJ3_CV_USRDRV
    tristate "CV XJ3 USRDRV Driver"
    help
       Driver for the user mode drive

menuconfig HOBOT_PM_PERF
	bool "Performance Sub-System Drivers Support on Hobot Platform"
	depends on ARCH_HOBOT
	default n
	help
	  Say yes to enable PM Sub-System drivers for Hobot JPlus SoCs

if HOBOT_PM_PERF

source "drivers/soc/hobot/performance/Kconfig"

endif #HOBOT_PM_PERF

endif #HOBOT_SOC_DRIVERS

menuconfig HOBOT_BIF_AP
        bool "Enable HOBOT BIF AP Drivers"
        default n
        help
          Say yes to enable bif AP side driver

if HOBOT_BIF_AP
config HOBOT_BIFSD
        tristate "Enable HOBOT BIF SD Drivers"
        default n
        help
          Say yes to enable bifsd AP side driver

config HOBOT_BIFSPI
        tristate "Enable HOBOT BIF SPI Drivers"
        default n
        help
          Say yes to enable bifspi AP side driver

endif

config HOBOT_CR5_SERVICE
        tristate "HOBOT CR5 Service Drivers"
        default n
        ---help---
           Drivers for the HOBOT CR5 Service
```

## drivers/soc/hobot/bpu/Kconfig
```kconfig
#
# HOBOT BPU drivers
#
menuconfig HOBOT_BPU
	bool "HOBOT BPU subsystem support"

if HOBOT_BPU

config BPU
	tristate "BPU framework driver"
	default y
	help
	  Say y here to support the hobot BPU(Brain Processing Unit)

	  If unsure, say N.

endif # HOBOT_BPU
```

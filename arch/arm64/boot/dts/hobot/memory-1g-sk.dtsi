#include "memory.dtsi"
/ {
	reserved-memory {
		/*Reserved 32M memory for iar subsystem*/
		iar_reserved: iar_reserved@0x02100000 {
			reg = <0x0 0x02100000 0x0 0x2000000>;
			no-map;
		};

		/* Reserved 520MB(isp,ipu,bpu) memory for ion*/
		ion_reserved: ion_reserved@0x04100000 {
			compatible = "ion-pool";
			reg = <0x0 0x04100000 0x0 0x20800000>;
		};

	};
};

#include "memory.dtsi"
/ {
	reserved-memory {

		/*Reserved 0 memory for iar subsystem*/
		iar_reserved: iar_reserved@0x02100000 {
			reg = <0x0 0x02100000 0x0 0x00000>;
			no-map;
		};

		/* Reserved 256 memory for ion*/
		ion_reserved: ion_reserved@0x02100000{
			compatible = "ion-pool";
			reg = <0x0 0x02100000 0x0 0x10000000>;
		};
	};
};

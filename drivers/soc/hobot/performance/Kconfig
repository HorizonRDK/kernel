## drivers/soc/hobot/performance/Kconfig
```kconfig
config HOBOT_CPUFREQ_QOS
	bool "Hobot cpufreq qos services"
	depends on ARCH_HOBOT
	depends on PM
	default n
	help
	  Use hobot cpufreq qos to boost cpufreq.
```

## drivers/staging/marvell/SD-8801-U16-MMC-W14.68.36.p139-C4X14635_B0-GPL/wlan_src/Kconfig
```kconfig
config MRVL_SD8801
	tristate "Marvel 8801 SDIO WiFi"
	depends on MAC80211
    depends on CFG80211
    default n
	---help---
	  Help message of MRVL_SD8801
```

## sound/soc/hobot/Kconfig
```kconfig
config X2_AUDIO
	tristate "x2 audio"
	depends on ARCH_HOBOT
	default n
	help
	  X2
	  audio
	  interface
	  info

config HOBOT_AUDIO
	tristate "hobot audio use dts"
	depends on ARCH_HOBOT
	default n

config HOBOT_1977
        tristate "hobot audio use dts 1977"
        depends on ARCH_HOBOT
        default n

config HOBOT_102
        tristate "hobot audio use dts ac102"
        depends on ARCH_HOBOT
        default n

config HOBOT_DUMMY
        tristate "hobot audio use dts dummy"
        depends on ARCH_HOBOT
        default n

config HOBOT_101
        tristate "hobot audio use dts ac101"
        depends on ARCH_HOBOT
        default n

config HOBOT_96BOARD
        tristate "hobot audio use dts 96board"
        depends on ARCH_HOBOT
        default n

config HOBOT_AUDIO_ES7210
	tristate "hobot audio es7210 sound card"
	depends on ARCH_HOBOT
	default n
```

## sound/soc/x2/Kconfig
```kconfig
config X2_I2S
	tristate "x2 i2s"
	depends on ARCH_HOBOT
	default n
	help
	  X2 i2s interface

config X2_RAW_I2S
    tristate "X2 I2S Driver"
    default n
    ---help---
        Driver for the X2 I2S
```
